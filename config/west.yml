## config/west.yml
```yaml
manifest:
  remotes:
    - name: zmkfirmware
      url-base: https://github.com/NikolaRavic
  projects:
    - name: zmk-firmware
      remote: NikolaRavic
      revision: main
      import: app/west.yml
  self:
    path: config
```
